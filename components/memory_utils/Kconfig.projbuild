## components/memory_utils/Kconfig.projbuild
```kconfig
menu "Memory Debug Utilities"

config HEAP_MEM_DEBUG
    bool "Print out heap memory status for debugging"
    default n

config HEAP_MEM_PERIOD
    int "Period in milliseconds to print heap memory status"
    default 1000

endmenu
```

## components/wifi_connect/Kconfig.projbuild
```kconfig
menu "Wifi Connect Config"

config WIFI_SSID
    string "Enter wifi SSID to connect to"
    default "Wifi SSID not set"

config WIFI_PASSWORD
    string "Enter wifi password"
    default "no password"

endmenu
```
